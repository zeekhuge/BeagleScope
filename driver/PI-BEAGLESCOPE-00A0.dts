/*
 * Copyright (c) 2016 Zubeen Tolani <ZeekHuge - zeekhuge@gmail.com>
 *
 * This program is free software; you can redistribute it and/or modify it
 * under the terms of the GNU General Public License version 2 as published by
 * the Free Software Foundation.
 */

/dts-v1/;
/plugin/;

/{
    compatible = "ti,beaglebone", "ti,beaglebone-black";
    part-number = "BEAGLESCOPE";
    version = "00A0";

    /* identification */

	fragment@0 {
		target = <&ocp>;
		__overlay__ {
			parallel_interface {
				status="okay";
				compatible = "ti,parallel_interface";
			};

		};

	};
};
